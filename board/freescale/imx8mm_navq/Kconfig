## board/freescale/imx8mm_navq/Kconfig
```kconfig
if TARGET_IMX8MM_NAVQ || TARGET_IMX8MM_DDR4_NAVQ

config SYS_BOARD
	default "imx8mm_navq"

config SYS_VENDOR
	default "freescale"

config SYS_CONFIG_NAME
	default "imx8mm_navq"

source "board/freescale/common/Kconfig"

endif
```
